## firmware/main/Kconfig.projbuild
```kconfig
menu "SpineGuard LGBM firmware"

config SPINEGUARD_FIRMWARE_VERSION
    string "Firmware version"
    default "0.5.0-device-management"

config SPINEGUARD_BACKEND_BASE_URL
    string "Default backend base URL"
    default "http://192.168.1.100:8000/api/v1"
    help
        Fallback address before a different URL is saved through the setup page.
        Use the base path ending at /api/v1.

config SPINEGUARD_SNTP_SERVER
    string "SNTP server"
    default "pool.ntp.org"

config SPINEGUARD_WIFI_MAX_RETRY
    int "Wi-Fi reconnect attempts before setup AP"
    range 1 100
    default 10

config SPINEGUARD_TELEMETRY_INTERVAL_MS
    int "Telemetry upload interval (ms)"
    range 500 60000
    default 2000

config SPINEGUARD_DEVICE_CONFIG_POLL_INTERVAL_MS
    int "Remote device configuration poll interval (ms)"
    range 1000 60000
    default 5000

config SPINEGUARD_REGISTRATION_RETRY_INTERVAL_MS
    int "Device registration retry interval (ms)"
    range 10000 300000
    default 60000

config SPINEGUARD_POWER_SOURCE
    string "Current power source label"
    default "power_bank"

config SPINEGUARD_SETUP_AP_PASSWORD
    string "Setup AP password"
    default "spineguard"
    help
        At least 8 characters for WPA2. The AP is named with the MAC-derived id.

config SPINEGUARD_VIBRATION_DEFAULT_ENABLED
    bool "Enable vibration by default"
    default y

config SPINEGUARD_REMINDER_TRIGGER_DEFAULT_S
    int "Default bad-posture trigger duration (s)"
    range 5 3600
    default 300

config SPINEGUARD_REMINDER_DURATION_DEFAULT_S
    int "Default vibration duration (s)"
    range 1 120
    default 30

config SPINEGUARD_REMINDER_COOLDOWN_DEFAULT_S
    int "Default repeated-reminder cooldown (s)"
    range 30 7200
    default 600

config SPINEGUARD_REMINDER_INTENSITY_DEFAULT_PERCENT
    int "Default vibration intensity (%)"
    range 1 100
    default 70

config SPINEGUARD_VIBRATION_MAX_PERCENT
    int "Maximum allowed PWM duty (%)"
    range 20 100
    default 70
    help
        The current 1027 motors may be rated below the 5 V VM rail. Keep this
        limit conservative until the actual motor voltage/current is verified.

config SPINEGUARD_MOTOR_PWM_FREQUENCY_HZ
    int "Motor PWM frequency (Hz)"
    range 1000 40000
    default 20000

config SPINEGUARD_MOTOR_SELF_TEST
    bool "Run four-motor self-test at boot"
    default y

endmenu
```

## firmware/sdkconfig.defaults
```kconfig
# ESP32-S3-DevKitC-1-N32R16V
CONFIG_ESPTOOLPY_OCT_FLASH=y
CONFIG_ESPTOOLPY_FLASHMODE_OPI=y
CONFIG_ESPTOOLPY_FLASHMODE="opi"
CONFIG_ESPTOOLPY_FLASHSIZE_32MB=y
CONFIG_ESPTOOLPY_FLASHSIZE="32MB"
CONFIG_ESP_MAIN_TASK_STACK_SIZE=8192
# Use a larger application partition for the embedded LightGBM model.
CONFIG_PARTITION_TABLE_CUSTOM=y
CONFIG_PARTITION_TABLE_CUSTOM_FILENAME="partitions.csv"
CONFIG_PARTITION_TABLE_FILENAME="partitions.csv"


# OTA rollback support
CONFIG_BOOTLOADER_APP_ROLLBACK_ENABLE=y
```
